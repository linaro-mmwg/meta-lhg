## conf/bblayers.conf.sample
```bitbake
# LAYER_CONF_VERSION is increased each time build/conf/bblayers.conf
# changes incompatibly
LCONF_VERSION = "6"

BBPATH = "${TOPDIR}"
BBFILES ?= ""
OEROOT := "${@os.path.abspath(os.path.dirname(d.getVar('FILE', True)) + '/../..')}"

BBLAYERS ?= " \
  ${OEROOT}/openembedded-core/meta \
  ${OEROOT}/meta-openembedded/meta-oe \
  ${OEROOT}/meta-openembedded/meta-systemd \
  ${OEROOT}/meta-openembedded/meta-webserver \
  ${OEROOT}/meta-openembedded/meta-multimedia \
  ${OEROOT}/meta-openembedded/meta-networking \
  ${OEROOT}/meta-openembedded/meta-python \
  "
BBLAYERS_NON_REMOVABLE ?= " \
  ${OEROOT}/openembedded-core/meta \
  "

# Linaro
BBLAYERS += "${@'${OEROOT}/meta-linaro/meta-linaro' if os.path.isfile('${OEROOT}/meta-linaro/meta-linaro/conf/layer.conf') else ''}"
BBLAYERS += "${@'${OEROOT}/meta-linaro/meta-linaro-toolchain' if os.path.isfile('${OEROOT}/meta-linaro/meta-linaro-toolchain/conf/layer.conf') else ''}"

# specific to LOF
BBLAYERS += "${@'${OEROOT}/meta-lhg' if os.path.isfile('${OEROOT}/meta-lhg/conf/layer.conf') else ''}"
```

## conf/distro/lof.conf
```bitbake
# Distribution definition for: Linaro OpenFramework

DISTRO = "lof"
DISTRO_NAME = "Linaro OpenFramework"
DISTRO_VERSION = "0.1"

MAINTAINER = "Andrey Konovalov <andrey.konovalov@linaro.org>"

PREFERRED_PROVIDER_virtual/libgles1_hikey = "mali450-userland-drm"
PREFERRED_PROVIDER_virtual/libgles2_hikey = "mali450-userland-drm"
PREFERRED_PROVIDER_virtual/egl_hikey = "mali450-userland-drm"

PREFERRED_PROVIDER_virtual/kernel_hikey = "linux-hikey"

LOCALCONF_VERSION = "1"
LAYER_CONF_VERSION ?= "6"

DISTRO_FEATURES = " \
        alsa argp ext2 ext4 largefile usbgadget usbhost \
        ipv4 ipv6 wifi nfs zeroconf \
        xattr \
        ${DISTRO_FEATURES_LIBC}"

DISTRO_FEATURES_append = " opengl multiarch"

# add support of wayland
DISTRO_FEATURES_append += " wayland pam"
# add support of systemd
DISTRO_FEATURES_append += " systemd"

DISTRO_FEATURES_BACKFILL_CONSIDERED += " sysvinit"
VIRTUAL-RUNTIME_init_manager = "systemd"
VIRTUAL-RUNTIME_initscripts = "systemd-compat-units"

#mirror
PREMIRRORS ??= "\
bzr://.*/.*   http://downloads.yoctoproject.org/mirror/sources/ \n \
cvs://.*/.*   http://downloads.yoctoproject.org/mirror/sources/ \n \
git://.*/.*   http://downloads.yoctoproject.org/mirror/sources/ \n \
gitsm://.*/.* http://downloads.yoctoproject.org/mirror/sources/ \n \
hg://.*/.*    http://downloads.yoctoproject.org/mirror/sources/ \n \
osc://.*/.*   http://downloads.yoctoproject.org/mirror/sources/ \n \
p4://.*/.*    http://downloads.yoctoproject.org/mirror/sources/ \n \
svn://.*/.*   http://downloads.yoctoproject.org/mirror/sources/ \n"

MIRRORS =+ "\
ftp://.*/.*      http://downloads.yoctoproject.org/mirror/sources/ \n \
http://.*/.*     http://downloads.yoctoproject.org/mirror/sources/ \n \
https://.*/.*    http://downloads.yoctoproject.org/mirror/sources/ \n"

# append Linaro mirrors as our last chance to find what we are looking for
MIRRORS =+ "\
git://.*/.*      http://snapshots.linaro.org/openembedded/sources/ \n \
svn://.*/.*      http://snapshots.linaro.org/openembedded/sources/ \n \
bzr://.*/.*      http://snapshots.linaro.org/openembedded/sources/ \n \
ftp://.*/.*      http://snapshots.linaro.org/openembedded/sources/ \n \
http://.*/.*     http://snapshots.linaro.org/openembedded/sources/ \n \
https://.*/.*    http://snapshots.linaro.org/openembedded/sources/ \n"

#for gstreamer libav
LICENSE_FLAGS_WHITELIST += " commercial"
```

## meta-lhg-integration/conf/layer.conf
```bitbake
# We have a conf and classes directory, add to BBPATH
BBPATH .= ":${LAYERDIR}"

# We have recipes-* directories, add to BBFILES
BBFILES += "${LAYERDIR}/recipes-*/*/*.bb \
	${LAYERDIR}/recipes-*/*/*.bbappend"

BBFILE_COLLECTIONS += "lhg-integration"
BBFILE_PATTERN_lhg-integration = "^${LAYERDIR}/"
BBFILE_PRIORITY_lhg-integration = "7"

LAYERSERIES_COMPAT_lhg-integration = "thud warrior zeus"
```

## meta-lhg-wpe/conf/layer.conf
```bitbake
# We have a conf and classes directory, add to BBPATH
BBPATH .= ":${LAYERDIR}"

# We have recipes-* directories, add to BBFILES
BBFILES += "${LAYERDIR}/recipes-*/*/*.bb \
	${LAYERDIR}/recipes-*/*/*.bbappend"

BBFILE_COLLECTIONS += "lhg-wpe"
BBFILE_PATTERN_lhg-wpe = "^${LAYERDIR}/"
BBFILE_PRIORITY_lhg-wpe = "7"

LAYERSERIES_COMPAT_lhg-integration = "warrior"
```

## meta-lhg/conf/layer.conf
```bitbake
# We have a conf and classes directory, add to BBPATH
BBPATH .= ":${LAYERDIR}"

# We have recipes-* directories, add to BBFILES
BBFILES += "${LAYERDIR}/recipes-*/*/*.bb \
	${LAYERDIR}/recipes-*/*/*.bbappend"

BBFILE_COLLECTIONS += "lhg"
BBFILE_PATTERN_lhg = "^${LAYERDIR}/"
BBFILE_PRIORITY_lhg = "7"

LAYERSERIES_COMPAT_lhg = "warrior zeus dunfell"
```
